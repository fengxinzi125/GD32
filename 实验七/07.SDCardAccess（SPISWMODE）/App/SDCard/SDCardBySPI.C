/*********************************************************************************************************
* 模块名称：SDCardBySPI.c
* 摘    要：SD卡驱动模块
* 当前版本：1.0.0
* 作    者：Leyutek(COPYRIGHT 2018 - 2021 Leyutek. All rights reserved.)
* 完成日期：2021年07月01日
* 内    容：
* 注    意：使用软件SPI驱动
**********************************************************************************************************
* 取代版本：
* 作    者：
* 完成日期：
* 修改内容：
* 修改文件：
*********************************************************************************************************/

/*********************************************************************************************************
*                                              包含头文件
*********************************************************************************************************/
#include "SDCardBySPI.h"
#include "gd32f30x_conf.h"
#include "SysTick.h"

/*********************************************************************************************************
*                                              宏定义
*********************************************************************************************************/

/*********************************************************************************************************
*                                              枚举结构体
*********************************************************************************************************/

/*********************************************************************************************************
*                                              内部变量定义
*********************************************************************************************************/
unsigned int s_iSDCardType = 0;//SD卡的类型 

/*********************************************************************************************************
*                                              内部函数声明
*********************************************************************************************************/
static void InitBSP(void);                    //硬件层初始化
static u8   ReadWriteByte(u8 data);           //读写单字节
static void SetSpeedLow(void);                //设置低速传输
static void SetSpeedHigh(void);               //设置高速传输
static void DisSelect(void);                  //取消片选
static u32  EnSelect(void);                   //使能片选
static u32  WaitReady(void);                  //使能片选
static u32  GetResponse(u8 response);         //等待SD卡回应
static u32  RecvData(u8* buf, u32 len);       //从SD卡读取数据
static u32  SendBlock(u8*buf, u8 cmd);        //SD卡写入一个数据包的内容
static u32  SendCmd(u8 cmd, u32 arg, u8 crc); //向SD卡发送一个命令

/*********************************************************************************************************
*                                              内部函数实现
*********************************************************************************************************/
/*********************************************************************************************************
* 函数名称：InitBSP
* 函数功能：硬件层初始化
* 输入参数：void
* 输出参数：void
* 返 回 值：void
* 创建日期：2021年07月01日
* 注    意：
*********************************************************************************************************/
static void InitBSP(void)
{
  //使能RCU相关时钟
  rcu_periph_clock_enable(RCU_GPIOC);  //使能GPIOC的时钟
  rcu_periph_clock_enable(RCU_GPIOD);  //使能GPIOD的时钟
  
  //CS
  gpio_init(GPIOC, GPIO_MODE_OUT_PP, GPIO_OSPEED_50MHZ, GPIO_PIN_11); //推完输出
  gpio_bit_set(GPIOC, GPIO_PIN_11);                                   //拉高片选
  
  //CLK
  gpio_init(GPIOC, GPIO_MODE_OUT_PP, GPIO_OSPEED_50MHZ, GPIO_PIN_12);  //推完输出
  gpio_bit_set(GPIOC, GPIO_PIN_12);                                    //拉高时钟线

  //MOSI
  gpio_init(GPIOD, GPIO_MODE_OUT_PP, GPIO_OSPEED_50MHZ, GPIO_PIN_2);  //推完输出
  gpio_bit_set(GPIOD, GPIO_PIN_2);                                    //MOSI默认输出高电平

  //MISO
  gpio_init(GPIOC, GPIO_MODE_IPU, GPIO_OSPEED_50MHZ, GPIO_PIN_8);     //上拉输入

  //CD
  gpio_init(GPIOD, GPIO_MODE_IPU, GPIO_OSPEED_50MHZ, GPIO_PIN_3);     //上拉输入
}

/*********************************************************************************************************
* 函数名称：ReadWriteByte
* 函数功能：读写单字节
* 输入参数：data：需要发送的数据
* 输出参数：void
* 返 回 值：读到的数据
* 创建日期：2021年07月01日
* 注    意：
*********************************************************************************************************/
static u8 ReadWriteByte(u8 data)
{
  u8 i, readData;

  readData = 0;
  for(i = 0; i < 8; i++)
  {
    //拉低时钟线
    gpio_bit_reset(GPIOC, GPIO_PIN_12); 

    //设置MOSI输出
    if(data & 0x80)
    {
      gpio_bit_set(GPIOD, GPIO_PIN_2);
    }
    else
    {
      gpio_bit_reset(GPIOD, GPIO_PIN_2);
    }

    //延时
    DelayNus(10);

    //拉高时钟线
    gpio_bit_set(GPIOC, GPIO_PIN_12);

    //延时
    DelayNus(10);

    //获取MISO输入
    readData = (readData << 1) | gpio_input_bit_get(GPIOC, GPIO_PIN_8);

    //发送数据左移
    data = data << 1;
  }

  //返回接收到的数据
  return readData;
}

/*********************************************************************************************************
* 函数名称：SetSpeedLow
* 函数功能：设置低速传输
* 输入参数：void
* 输出参数：void
* 返 回 值：void
* 创建日期：2021年07月01日
* 注    意：SD卡初始化的时候,需要低速
*********************************************************************************************************/
static void SetSpeedLow(void)
{

}

/*********************************************************************************************************
* 函数名称：SetSpeedHigh
* 函数功能：设置高速传输
* 输入参数：void
* 输出参数：void
* 返 回 值：void
* 创建日期：2021年07月01日
* 注    意：SD卡正常工作的时候,可以高速了
*********************************************************************************************************/
static void SetSpeedHigh(void)
{

}

/*********************************************************************************************************
* 函数名称：DisSelect
* 函数功能：取消片选
* 输入参数：void
* 输出参数：void
* 返 回 值：void
* 创建日期：2021年07月01日
* 注    意：释放完片选后需要提供额外的8个时钟
*********************************************************************************************************/
static void DisSelect(void)
{
  gpio_bit_set(GPIOC, GPIO_PIN_11);
  ReadWriteByte(0xFF);
}

/*********************************************************************************************************
* 函数名称：EnSelect
* 函数功能：使能片选，并且等待卡准备OK
* 输入参数：void
* 输出参数：void
* 返 回 值：0-成功，1-失败
* 创建日期：2021年07月01日
* 注    意：
*********************************************************************************************************/
static u32 EnSelect(void)
{
  gpio_bit_reset(GPIOC, GPIO_PIN_11);

  //等待卡准备OK
  if(WaitReady() == 0)
  {
    //等待成功
    return 0;
  }

  //等待失败
  DisSelect();
  return 1;
}

/*********************************************************************************************************
* 函数名称：WaitReady
* 函数功能：使能片选，并且等待卡准备OK
* 输入参数：void
* 输出参数：void
* 返 回 值：0-准备好了，其他-错误代码
* 创建日期：2021年07月01日
* 注    意：
*********************************************************************************************************/
static u32 WaitReady(void)
{
  u32 t = 0;

  //超时等待
  while(t < 0xFFFFFF)
  {
    if(ReadWriteByte(0xFF) == 0xFF)
    {
      return 0;
    }
    t++;
  }

  //等待超时
  return 1;
}

/*********************************************************************************************************
* 函数名称：GetResponse
* 函数功能：等待SD卡回应
* 输入参数：response：要得到的回应值
* 输出参数：void
* 返 回 值：0-成功得到了该回应值，其他-得到回应值失败
* 创建日期：2021年07月01日
* 注    意：
*********************************************************************************************************/
static u32 GetResponse(u8 response)
{
  //等待次数
  u16 count = 0xFFFF;

  //等待得到准确的回应
  while ((ReadWriteByte(0xFF) != response) && count)
  {
    count--;
  }

  //得到回应失败
  if(0 == count)
  {
    return MSD_RESPONSE_FAILURE;
  }

  //正确回应
  else 
  {
    return MSD_RESPONSE_NO_ERROR;
  }
}

/*********************************************************************************************************
* 函数名称：RecvData
* 函数功能：从SD卡读取一个数据包的内容
* 输入参数：buf:数据缓存区，len:要读取的数据长度
* 输出参数：void
* 返 回 值：0-成功，其他-失败
* 创建日期：2021年07月01日
* 注    意：
*********************************************************************************************************/
static u32 RecvData(u8* buf, u32 len)
{
  //等待SD卡发回数据起始令牌0xFE
  if(GetResponse(0xFE))
  {
    return 1;
  }

  //开始接收数据
  while(len--)
  {
    *buf = ReadWriteByte(0xFF);
    buf++;
  }

  //下面是2个伪CRC（dummy CRC）
  ReadWriteByte(0xFF);
  ReadWriteByte(0xFF);

  //读取成功
  return 0;
}

/*********************************************************************************************************
* 函数名称：SendBlock
* 函数功能：向SD卡写入一个数据包的内容 512字节
* 输入参数：buf:数据缓存区，cmd:指令
* 输出参数：void
* 返 回 值：0-成功，其他-失败
* 创建日期：2021年07月01日
* 注    意：
*********************************************************************************************************/
static u32 SendBlock(u8*buf, u8 cmd)
{
  u16 t;

  //等待准备失效
  if(WaitReady())
  {
    return 1;
  }

  //发送命令
  ReadWriteByte(cmd);

  //不是结束指令
  if(cmd != 0XFD)
  {
    for(t = 0; t < 512; t++)
    {
      ReadWriteByte(buf[t]);
    }

    //忽略crc
    ReadWriteByte(0xFF);
    ReadWriteByte(0xFF);

    //接收响应
    t = ReadWriteByte(0xFF);
    if((t & 0x1F) != 0x05)
    {
      return 2;//响应错误
    }
  }
  
  //写入成功
  return 0;
}

/*********************************************************************************************************
* 函数名称：SendCmd
* 函数功能：向SD卡发送一个命令
* 输入参数：cmd：命令，arg：命令参数，crc：校验值
* 输出参数：void
* 返 回 值：SD卡返回的响应
* 创建日期：2021年07月01日
* 注    意：
*********************************************************************************************************/
static u32 SendCmd(u8 cmd, u32 arg, u8 crc)
{
  u8 r1;
  u8 retry;

  //取消上次片选
  DisSelect();

  //使能片选
  if(EnSelect())
  {
    return 0xFF; 
  }

  //发送命令
  ReadWriteByte(cmd | 0x40);
  ReadWriteByte(arg >> 24);
  ReadWriteByte(arg >> 16);
  ReadWriteByte(arg >> 8);
  ReadWriteByte(arg);
  ReadWriteByte(crc);
  if(cmd == CMD12)
  {
    ReadWriteByte(0xFF);
  }

  //等待响应，或超时退出
  retry = 0X1F;
  do
  {
    r1 = ReadWriteByte(0xFF);
  }while((r1 & 0x80) && retry--);

  //返回状态值
  return r1;
}

/*********************************************************************************************************
*                                              API函数实现
*********************************************************************************************************/
/*********************************************************************************************************
* 函数名称：SDGetCID
* 函数功能：获取SD卡的CID信息，包括制造商信息
* 输入参数：cid：存放CID的内存，至少16Byte
* 输出参数：void
* 返 回 值：0-成功，其他-失败
* 创建日期：2021年07月01日
* 注    意：
*********************************************************************************************************/
u32 SDGetCID(u8* cid)
{
  u8 r1;

  //发CMD10命令，读CID
  r1 = SendCmd(CMD10, 0, 0x01);
  if(0x00 == r1)
  {
    //接收16个字节的数据
    r1 = RecvData(cid, 16);
  }

  //取消片选
  DisSelect();

  //校验
  if(r1)
  {
    return 1;
  }
  else 
  {
    return 0;
  }
}

/*********************************************************************************************************
* 函数名称：SDGetCSD
* 函数功能：获取SD卡的CSD信息，包括容量和速度信息
* 输入参数：csd：存放CID的内存，至少16Byte
* 输出参数：void
* 返 回 值：0-成功，其他-失败
* 创建日期：2021年07月01日
* 注    意：
*********************************************************************************************************/
u32 SDGetCSD(u8 *csd)
{
  u8 r1;

  //发CMD9命令，读CSD
  r1 = SendCmd(CMD9, 0, 0x01);
  if(0x00 == r1)
  {
    //接收16个字节的数据
    r1 = RecvData(csd, 16);
  }

  //取消片选
  DisSelect();

  //校验
  if(r1)
  {
    return 1;
  }
  else 
  {
    return 0;
  }
}

/*********************************************************************************************************
* 函数名称：SDGetSectorCount
* 函数功能：获取SD卡的总扇区数（扇区数）
* 输入参数：csd：存放CID的内存，至少16Byte
* 输出参数：void
* 返 回 值：0-取容量出错，其他-SD卡的容量(扇区数/512字节)
* 创建日期：2021年07月01日
* 注    意：每扇区的字节数必为512，因为如果不是512，则初始化不能通过
*********************************************************************************************************/
u32 SDGetSectorCount(void)
{
  u8  csd[16];
  u32 capacity;
  u8  n;
  u16 csize;

  //取CSD信息，如果期间出错，返回0
  if(SDGetCSD(csd) != 0)
  {
    return 0;
  }

  //如果为SDHC卡（V2.00的卡），按照下面方式计算
  if((csd[0] & 0xC0) == 0x40)
  {
    csize = csd[9] + ((u16)csd[8] << 8) + 1;

    //得到扇区数
    capacity = (u32)csize << 10;
  }
  
  //V1.XX的卡
  else
  {
    n = (csd[5] & 15) + ((csd[10] & 128) >> 7) + ((csd[9] & 3) << 1) + 2;
    csize = (csd[8] >> 6) + ((u16)csd[7] << 2) + ((u16)(csd[6] & 3) << 10) + 1;

    //得到扇区数
    capacity= (u32)csize << (n - 9);
  }
  return capacity;
}

/*********************************************************************************************************
* 函数名称：InitSDCard
* 函数功能：初始化SD卡
* 输入参数：void
* 输出参数：void
* 返 回 值：0-成功，其他-失败
* 创建日期：2021年07月01日
* 注    意：void
*********************************************************************************************************/
u32 InitSDCard(void)
{
  u8   r1;    //存放SD卡的返回值
  u16 retry;  //用来进行超时计数
  u8  buf[4];  
  u16 i;

  //初始化IO
  InitBSP();

  //设置到低速模式
  SetSpeedLow();

  //发送最少74个脉冲
  for(i = 0;i < 10; i++)
  {
    ReadWriteByte(0xFF);
  }
  
  //进入IDLE状态
  retry = 20;
  do
  {
    r1 = SendCmd(CMD0, 0, 0x95);
  }while((r1 != 0X01) && retry--);

  //开始初始化
  s_iSDCardType = 0;//默认无卡
  if(r1 == 0X01)
  {
    //检查是否是SD V2.0
    if(SendCmd(CMD8,0x1AA,0x87)==1)
    {
      //Get trailing return value of R7 resp
      for(i = 0; i < 4; i++)
      {
        buf[i] = ReadWriteByte(0xFF); 
      }

      //卡是否支持2.7~3.6V
      if(buf[2] == 0X01 && buf[3] == 0xAA)
      {
        retry = 0XFFFE;
        do
        {
          //发送CMD55
          SendCmd(CMD55, 0, 0x01);

          //发送CMD41
          r1 = SendCmd(CMD41, 0x40000000, 0X01);
        }while(r1 && retry--);

        //开始鉴别SD2.0卡版本
        if(retry && SendCmd(CMD58, 0, 0x01) == 0)
        {
          //得到OCR值
          for(i = 0; i < 4; i++)
          {
            buf[i] = ReadWriteByte(0XFF);
          }

          //检查CCS
          if(buf[0] & 0x40)
          {
            s_iSDCardType = SD_TYPE_V2HC;
          }
          else 
          {
            s_iSDCardType = SD_TYPE_V2;
          }
        }
      }
    }
    
    //检查是否是SD V1.x/ MMC V3
    else
    {
      //发送CMD55
      SendCmd(CMD55, 0, 0x01);

      //发送CMD41
      r1 = SendCmd(CMD41, 0, 0x01);
      if(r1 <= 1)
      {
        s_iSDCardType = SD_TYPE_V1;
        retry = 0XFFFE;

        //等待退出IDLE模式
        do
        {
          //发送CMD55
          SendCmd(CMD55, 0, 0x01);

          //发送CMD41
          r1 = SendCmd(CMD41, 0, 0x01);
        }while(r1 && retry--);
      }
      
      //MMC卡不支持CMD55+CMD41识别
      else
      {
        //MMC V3
        s_iSDCardType = SD_TYPE_MMC; 
        retry = 0XFFFE;

        //等待退出IDLE模式
        do 
        {
          //发送CMD1
          r1 = SendCmd(CMD1, 0, 0x01);
        }while(r1 && retry--);
      }

      //错误的卡
      if(retry == 0 || SendCmd(CMD16,512,0X01) != 0)
      {
        s_iSDCardType = SD_TYPE_ERR;
      }
    }
  }

  //取消片选
  DisSelect();

  //进入高速模式
  SetSpeedHigh();
  if(s_iSDCardType)
  {
    return 0;
  }
  else if(r1)
  {
    return r1;
  }

  //其他错误
  return 0xAA;
}

/*********************************************************************************************************
* 函数名称：SDReadSector
* 函数功能：读SD卡
* 输入参数：buf：数据缓存区，sector：扇区，sectorNum:扇区数
* 输出参数：void
* 返 回 值：0-成功，其他-失败
* 创建日期：2021年07月01日
* 注    意：void
*********************************************************************************************************/
u32 SDReadSector(u8* buf, u32 sector, u32 sectorNum)
{
  u8 r1;

  //转换为字节地址
  if(s_iSDCardType != SD_TYPE_V2HC)
  {
    sector <<= 9;
  }

  //读单扇区
  if(1 == sectorNum)
  {
    //发送读命令
    r1 = SendCmd(CMD17, sector, 0x01);

    //指令发送成功
    if(r1 == 0)
    {
      //接收512个字节
      r1 = RecvData(buf, 512);
    }
  }
  
  //读多扇区
  else
  {
    //连续读命令
    r1 = SendCmd(CMD18, sector, 0x01);
    do
    {
      //接收512个字节
      r1 = RecvData(buf, 512);
      buf += 512;
    }while(--sectorNum && 0 == r1);
    
    //发送停止命令
    SendCmd(CMD12, 0, 0x01);
  }

  //取消片选
  DisSelect();
  return r1;
}

/*********************************************************************************************************
* 函数名称：SDWriteSector
* 函数功能：写SD卡
* 输入参数：buf：数据缓存区，sector：扇区，sectorNum:扇区数
* 输出参数：void
* 返 回 值：0-成功，其他-失败
* 创建日期：2021年07月01日
* 注    意：void
*********************************************************************************************************/
u32 SDWriteSector(u8* buf, u32 sector, u32 sectorNum)
{
  u8 r1;

  //转换为字节地址
  if(s_iSDCardType != SD_TYPE_V2HC)
  {
    sector <<= 9;
  }

  //写单扇区
  if(1 == sectorNum)
  {
    //发送写命令
    r1 = SendCmd(CMD24, sector, 0x01);

    //指令发送成功
    if(0 == r1)
    {
      //写512个字节
      r1 = SendBlock(buf, 0xFE);
    }
  }
  
  //写多扇区
  else
  {
    //发送指令
    if(s_iSDCardType != SD_TYPE_MMC)
    {
      SendCmd(CMD55, 0, 0x01);
      SendCmd(CMD23, sectorNum, 0x01);
    }

    //连续写命令
    r1 = SendCmd(CMD25, sector, 0x01);
    if(0 == r1)
    {
      do
      {
        //发送512个字节
        r1 = SendBlock(buf,0xFC);
        buf += 512;
      }while(--sectorNum && r1 == 0);

      //结束
      r1 = SendBlock(0, 0xFD);
    }
  }

  //取消片选
  DisSelect();
  return r1;
}

/*********************************************************************************************************
* 函数名称：SDDetect
* 函数功能：查验SD卡是否插入
* 输入参数：void
* 输出参数：void
* 返 回 值：0-SD卡已插入，其他-SD卡脱落
* 创建日期：2021年07月01日
* 注    意：void
*********************************************************************************************************/
u32 SDDetect(void)
{
  if(0 == gpio_input_bit_get(GPIOD, GPIO_PIN_3))
  {
    return 0;
  }
  else
  {
    return 1;
  }
}
